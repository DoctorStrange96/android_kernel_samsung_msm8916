## arch/arm/configs/msm8916_sec_fortuna3g_ltn_dtv_defconfig
```kconfig
CONFIG_SEC_FORTUNA_PROJECT=y
CONFIG_MACH_FORTUNA3G_LTN_DTV=y

CONFIG_LOCALVERSION="-Raijin-G530BT-LOS14.1"
# CONFIG_LOCALVERSION_AUTO is not set

# HARD RESET
CONFIG_RESTART_REASON_SEC_PARAM=y
CONFIG_QCOM_HARDREBOOT_IMPLEMENTATION=n

# SS Pinctrl Driver
CONFIG_SEC_GPIO_SETTINGS=y

# MUIC
CONFIG_SM5502_MUIC=y
# CONFIG_MUIC_SM5502_SUPPORT_LANHUB_TA is not set
CONFIG_MUIC_SUPPORT_RUSTPROOF=y
CONFIG_USBID_STANDARD_VER_01=y

#Touch Screen
CONFIG_TOUCHSCREEN_ZINITIX_BT541=y

#Wifi
#
# Enable Qualcomm Wifi features
#
CONFIG_MSM_PIL_PRONTO=y
CONFIG_WCNSS_CORE=y
CONFIG_WCNSS_CORE_PRONTO=y
CONFIG_WCNSS_MEM_PRE_ALLOC=y

#
# Wifi features (Qualcomm)
#
CONFIG_PRONTO_WLAN=m
CONFIG_NET_CORE=y
CONFIG_WIRELESS=y
CONFIG_WIRELESS_EXT_SYSFS=y
CONFIG_WEXT_CORE=y
CONFIG_WEXT_PROC=y
CONFIG_CFG80211=y
CONFIG_CFG80211_DEFAULT_PS=y
#CONFIG_CFG80211_ALLOW_RECONNECT is not set
CONFIG_WLAN=y
CONFIG_WIRELESS_EXT=y
CONFIG_WEXT_PRIV=y
CONFIG_MODULES=y
CONFIG_MODULE_UNLOAD=y
CONFIG_MODULE_FORCE_UNLOAD=y
CONFIG_WCNSS_REGISTER_DUMP_ON_BITE =y

#AUDIO
CONFIG_RADIO_IRIS=y
CONFIG_RADIO_IRIS_TRANSPORT=y


#LCD
#CONFIG_FB_MSM_MIPI_HX8389C_QHD_VIDEO_PANEL=y
CONFIG_PANEL_HX8389C_GH9607501A_QHD=y
CONFIG_PANEL_S6D78A0_GH9607501A_QHD=y
CONFIG_FB_MSM_MDSS_SAMSUNG=y

#CHARGING/BATTERY
CONFIG_MFD_RT5033=y
CONFIG_MFD_RT5033_RESET_GPIO=n
CONFIG_MFD_RT5033_SLDO_VBUSDET=y
CONFIG_BATTERY_SAMSUNG=y
CONFIG_BATTERY_SAMSUNG_DATA_FILE="fortuna_battery_data.h"
CONFIG_SAMSUNG_LPM_MODE=y
CONFIG_CHARGER_RT5033=y
CONFIG_FUELGAUGE_RT5033=y
CONFIG_REGULATOR_RT5033=y

# VIBRATOR
CONFIG_MSM_VIBRATOR=y

#SENSOR
CONFIG_SENSORS=y
CONFIG_SENSORS_CORE=y
CONFIG_SENSORS_K303C=y
CONFIG_SENSORS_GP2A002=y
CONFIG_SENSORS_GP2A_VDD=y

#FLASH
CONFIG_FLASHLIGHT=y
CONFIG_RT_FLASH_LED=y
CONFIG_FLED_RT5033=y
CONFIG_FLED_RT5033_EXT_GPIO=y

# CAMERA
CONFIG_IMX219=y
CONFIG_S5K5E3YX=y

#APC CPR QUOTIENT
CONFIG_APC_CPR_QUOT_BOOST=y

#optimize mmc block delay on resume
#CONFIG_MMC_BLOCK_DEFERRED_RESUME=y

# RTCC v3
CONFIG_SWAP=y
CONFIG_FRONTSWAP=y
CONFIG_ZSMALLOC=y
CONFIG_ZSWAP=y

# DUAL SIM / SINGLE SIM Detection
CONFIG_CHECK_SIMSLOT_COUNT=y
CONFIG_CHECK_SIMSLOT_COUNT_GPIO=1008
```

## arch/arm/hotplug/Kconfig
```kconfig
config INTELLI_PLUG
        bool "Enable intelli-plug cpu hotplug driver"
        default n
        help
          Generic Intelli-plug cpu hotplug driver for ARM SOCs

config MSM_HOTPLUG
	bool "MSM hotplug driver"
	depends on HOTPLUG_CPU
	default y
	help
	  The MSM hotplug driver controls on-/offlining of additional cores based
	  on current cpu load.

config BRICKED_HOTPLUG
	   bool "Enable kernel based mpdecision"
	   depends on MSM_RUN_QUEUE_STATS
	   default y
	   help
		 This enables kernel based multi core control.
```
